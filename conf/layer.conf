## conf/layer.conf
```bitbake
# We have a conf and classes directory, add to BBPATH
BBPATH .= ":${LAYERDIR}"

# We have recipes-* directories, add to BBFILES
BBFILES += "${LAYERDIR}/recipes-*/*/*.bb \
            ${LAYERDIR}/recipes-*/*/*.bbappend"

BBFILE_COLLECTIONS += "cubiescreen"
BBFILE_PATTERN_cubiescreen = "^${LAYERDIR}/"
BBFILE_PRIORITY_cubiescreen = "5"
#LAYERVERSION_cubiescreen = "2"

#MACHINE_ESSENTIAL_EXTRA_RRECOMMENDS += "kernel-module"
```
